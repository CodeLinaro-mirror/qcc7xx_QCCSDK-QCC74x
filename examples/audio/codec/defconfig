## examples/audio/codec/defconfig
```kconfig
# Components
CONFIG_VLIBC =n
CONFIG_QCC74xLOG =y
CONFIG_FREERTOS =y
CONFIG_TLSF =y
CONFIG_SHELL =y
CONFIG_LWIP =y
CONFIG_WIFI6 =y
CONFIG_RF =y
CONFIG_MBEDTLS =y
CONFIG_VFS =y
CONFIG_PSRAM_HEAP =y
CONFIG_DHCPD =y
CONFIG_MQTT =y
CONFIG_ROMFS =y

CONFIG_VSNPRINTF_FLOAT =y
CONFIG_VSNPRINTF_FLOAT_EX =y
CONFIG_VSNPRINTF_LONG_LONG =y

# Config
## mbedtls
CONFIG_MBEDTLS_AES_USE_HW =n
CONFIG_MBEDTLS_BIGNUM_USE_HW =n
CONFIG_MBEDTLS_ECC_USE_HW =n
CONFIG_MBEDTLS_SHA1_USE_HW =n
CONFIG_MBEDTLS_SHA256_USE_HW =n
CONFIG_MBEDTLS_SHA512_USE_HW =n

# wifi
CONFIG_VIF_MAX =2
CONFIG_STA_MAX =4
CONFIG_MAC_TXQ_DEPTH =32
CONFIG_MAC_RXQ_DEPTH =12

# audio
CONFIG_MULTIMEDIA =y
CONFIG_AV =y
CONFIG_XCODEC =y
CONFIG_XPORT =y
CONFIG_XUTILS =y
CONFIG_CODEC_USE_I2S_TX =n
CONFIG_CODEC_USE_I2S_RX =n
CONFIG_MSP_USE_STATIC_RAM =n
CONFIG_MSP_USE_CODEC_ONLY =y
```

## examples/audio/player_mp3/defconfig
```kconfig
# Components
CONFIG_VLIBC =n
CONFIG_QCC74xLOG =y
CONFIG_FREERTOS =y
CONFIG_TLSF =y
CONFIG_SHELL =y
CONFIG_LWIP =y
CONFIG_WIFI6 =y
CONFIG_RF =y
CONFIG_MBEDTLS =y
CONFIG_VFS =y
CONFIG_PSRAM_HEAP =y
CONFIG_DHCPD =y
CONFIG_MQTT =y
CONFIG_QCC74x_MTD =y # For bt status save
CONFIG_PARTITION =y # For bt status save
CONFIG_EASYFLASH4 =y # For bt status save
CONFIG_ROMFS =y

## audio
CONFIG_MULTIMEDIA =y
CONFIG_ALGRTC =y

CONFIG_AACDEC =y
CONFIG_AMRNB =y
CONFIG_AMRWB =y
CONFIG_FLAC =y
CONFIG_PVMP3DEC =y
CONFIG_OGG =y
CONFIG_OPUS =y
CONFIG_VORBIS =y
CONFIG_SPEEX =y

CONFIG_DRV_SND_QCC743 =y
CONFIG_SMART_AUDIO_QCC743 =y
CONFIG_MINIALSA =y
CONFIG_SONIC =y
CONFIG_SPEEXDSP =y
CONFIG_USERVICE =y

CONFIG_AV =y
CONFIG_XCODEC =y
CONFIG_XPORT =y
CONFIG_XUTILS =y

CONFIG_VSNPRINTF_FLOAT =y
CONFIG_VSNPRINTF_FLOAT_EX =y
CONFIG_VSNPRINTF_LONG_LONG =y

# Config
## mbedtls
CONFIG_MBEDTLS_AES_USE_HW =n
CONFIG_MBEDTLS_BIGNUM_USE_HW =n
CONFIG_MBEDTLS_ECC_USE_HW =n
CONFIG_MBEDTLS_SHA1_USE_HW =n
CONFIG_MBEDTLS_SHA256_USE_HW =n
CONFIG_MBEDTLS_SHA512_USE_HW =n

# wifi
CONFIG_VIF_MAX =2
CONFIG_STA_MAX =4
CONFIG_MAC_TXQ_DEPTH =16
CONFIG_MAC_RXQ_DEPTH =12

# other
CONFIG_COREDUMP =n
CONFIG_CODEC_USE_I2S_TX =n
CONFIG_CODEC_USE_I2S_RX =n
CONFIG_MSP_USE_STATIC_RAM =n

CONFIG_POST_BUILDS_GENERATE_ROMFS =y
```

## examples/boot2_isp/defconfig
```kconfig
CONFIG_BOOT2 =y
CONFIG_QCC74xLOG =n
CONFIG_XZ =y
CONFIG_ROMAPI =y
CONFIG_VSNPRINTF_NANO =y
CONFIG_GCC_OPTIMISE_LEVEL =-Os
CONFIG_PM_PDS_FLASH_POWER_OFF =y
CONFIG_PM_PDS_PLL_POWER_OFF =y
CONFIG_PM_PDS_RF_POWER_OFF =y
CONFIG_ERR_NOT_DUMP_ALL_REGS =y
CONFIG_BOARD_FLASH_LOW_SPEED =y

CONFIG_CUSTOM_LINKSCRIPT =y
```

## examples/btble/blemesh_simple/defconfig
```kconfig
CONFIG_QCC74xLOG =n
CONFIG_FREERTOS =y
CONFIG_SHELL =y
CONFIG_BLUETOOTH =y
CONFIG_BTBLECONTROLLER_LIB =ble1m10s1bredr0
CONFIG_RF =y
CONFIG_BLE_USE_MAC2 =n
CONFIG_BT_STACK_CLI =n
CONFIG_BT_MESH =y
CONFIG_EASYFLASH4 =y
#CONFIG_LITTLEFS =y
#CONFIG_LITTLEFS_KV_EASYFLASH =y
CONFIG_QCC74x_MTD =y
CONFIG_PARTITION =y
CONFIG_BT_SETTINGS =y
```

## examples/btble/btble_cli/defconfig
```kconfig
CONFIG_QCC74xLOG =n
CONFIG_FREERTOS =y
CONFIG_SHELL =y
CONFIG_BLUETOOTH =y
CONFIG_BTBLECONTROLLER_LIB =ble1m2s1bredr0
CONFIG_RF =y
CONFIG_BLE_USE_MAC2 =n
CONFIG_BT_STACK_CLI =y
CONFIG_BT_MESH =y
CONFIG_BT_MESH_PROVISIONER =y
CONFIG_BT_MESH_MODEL =y
CONFIG_QCC74x_MTD =y
CONFIG_PARTITION =y
CONFIG_EASYFLASH4 =y
CONFIG_BT_SETTINGS =y
CONFIG_DISABLE_BT_HOST_PRIVACY =y
```

## examples/btble/btblecontroller_test/defconfig
```kconfig
CONFIG_QCC74xLOG =n
CONFIG_FREERTOS =y
CONFIG_SHELL =y
CONFIG_BLUETOOTH =y
CONFIG_BTBLECONTROLLER_LIB =bleuarthci
CONFIG_RF =y
CONFIG_BLE_USE_MAC2 =n
CONFIG_BT_STACK_CLI =n
CONFIG_QUALIFICATION =y
```

## examples/btble/peripheral/defconfig
```kconfig
CONFIG_QCC74xLOG =n
CONFIG_FREERTOS =y
CONFIG_SHELL =y
CONFIG_BLUETOOTH =y
CONFIG_BTBLECONTROLLER_LIB =ble1m0s1bredr0
CONFIG_RF =y
CONFIG_BLE_USE_MAC2 =n
CONFIG_QCC74x_MTD =y
CONFIG_PARTITION =y
CONFIG_EASYFLASH4 =y
CONFIG_QCC74x_SDK =y
CONFIG_BT_OAD_SERVER =y
CONFIG_BT_BAS_SERVER =y
CONFIG_BT_IAS_SERVER =y
CONFIG_BT_DIS_SERVER =y
CONFIG_BLE_TP_SERVER =y
```

## examples/crash/defconfig
```kconfig
CONFIG_QCC74xLOG =n
CONFIG_FREERTOS =y
CONFIG_SHELL =y
CONFIG_QCC74x_MTD =y
CONFIG_PARTITION =y
ifeq ($(BOARD),qcc744dk)
    CONFIG_PSRAM_COPY_CODE =y
endif
CONFIG_COREDUMP =y
```

## examples/easyflash/defconfig
```kconfig
CONFIG_LITTLEFS =y
CONFIG_LITTLEFS_KV_EASYFLASH =y

CONFIG_QCC74x_MTD =y
CONFIG_PARTITION =y
```

## examples/matter/thread/defconfig
```kconfig
# Components
CONFIG_NEWLIB =n
CONFIG_NEWLIB_STANDARD =n
CONFIG_FREERTOS =y
CONFIG_TLSF =y
CONFIG_SHELL =y
CONFIG_RF =y
CONFIG_MBEDTLS =y

CONFIG_VSNPRINTF_FLOAT =y
CONFIG_VSNPRINTF_FLOAT_EX =y
CONFIG_VSNPRINTF_LONG_LONG =y

# mbedtls
CONFIG_MBEDTLS_AES_USE_HW =y
CONFIG_MBEDTLS_BIGNUM_USE_HW =y
CONFIG_MBEDTLS_ECC_USE_HW =y
CONFIG_MBEDTLS_SHA1_USE_HW =y
CONFIG_MBEDTLS_SHA256_USE_HW =y
CONFIG_MBEDTLS_SHA512_USE_HW =y

CONFIG_BLUETOOTH =y
CONFIG_BTBLECONTROLLER_LIB =ble1m0s1bredr0
CONFIG_BLE_USE_MAC2 =n
CONFIG_BT_STACK_CLI =n
CONFIG_DISABLE_BT_HOST_PRIVACY =n

CONFIG_PARTITION =y
CONFIG_QCC74x_MTD =y

CONFIG_LITTLEFS =y

CONFIG_LMAC154 =y
CONFIG_THREAD =y

CONFIG_FOTA =y

CONFIG_MATTER_MFD =n
```

## examples/matter/wifi/defconfig
```kconfig
# Components
CONFIG_NEWLIB =n
CONFIG_NEWLIB_STANDARD =n
CONFIG_QCC74xLOG =n
CONFIG_FREERTOS =y
CONFIG_TLSF =y
CONFIG_SHELL =y
CONFIG_LWIP =y
CONFIG_WIFI6 =y
CONFIG_RF =y
CONFIG_MBEDTLS =y
#CONFIG_PSRAM =y
CONFIG_DHCPD =y
CONFIG_PING =y
#CONFIG_MQTT =y

CONFIG_VSNPRINTF_FLOAT =y
CONFIG_VSNPRINTF_FLOAT_EX =y
CONFIG_VSNPRINTF_LONG_LONG =y

# mbedtls
CONFIG_MBEDTLS_AES_USE_HW =y
CONFIG_MBEDTLS_BIGNUM_USE_HW =y
CONFIG_MBEDTLS_ECC_USE_HW =y
CONFIG_MBEDTLS_SHA1_USE_HW =y
CONFIG_MBEDTLS_SHA256_USE_HW =y
CONFIG_MBEDTLS_SHA512_USE_HW =y

# wifi
CONFIG_VIF_MAX =2
CONFIG_STA_MAX =4
CONFIG_MAC_TXQ_DEPTH =32
CONFIG_MAC_RXQ_DEPTH =12

CONFIG_BLUETOOTH =y
CONFIG_BTBLECONTROLLER_LIB =ble1m0s1bredr0
CONFIG_BLE_USE_MAC2 =n
CONFIG_BT_STACK_CLI =y
CONFIG_DISABLE_BT_HOST_PRIVACY =n

CONFIG_PARTITION =y
CONFIG_EASYFLASH4 =y
CONFIG_QCC74x_MTD =y


CONFIG_LITTLEFS =y

CONFIG_COEX =y
CONFIG_COEX_WIFI_MODE =y
CONFIG_COEX_THREAD_MODE =y
CONFIG_COEX_TDMA_NONE =2

CONFIG_FOTA =y

CONFIG_MATTER_MFD =n
```

## examples/mfg_test/defconfig
```kconfig
# Components
CONFIG_QCC74xLOG =y
CONFIG_FREERTOS =y
CONFIG_TLSF =y
CONFIG_SHELL =y
CONFIG_RF =y
#CONFIG_PSRAM_HEAP =y
CONFIG_LMAC154 =y
CONFIG_PHY_CLI =y
CONFIG_LINK_FOR_MFGTEST =y

CONFIG_VSNPRINTF_FLOAT =y
CONFIG_VSNPRINTF_FLOAT_EX =y
CONFIG_VSNPRINTF_LONG_LONG =y
CONFIG_COMPONENTS_RINGBUFFER_NO_INCLUDE =y

CONFIG_BLUETOOTH =y
CONFIG_BTBLECONTROLLER_LIB =mfg

CONFIG_CHERRYUSB =y
CONFIG_CHERRYUSB_OSAL =freertos
CONFIG_XTAL_SELECT_EN =y

ifeq ($(CONFIG_CHERRYUSB),y)
    CONFIG_MFG_USB_HOST_TEST =y
    CONFIG_CHERRYUSB_HOST =y
    CONFIG_CHERRYUSB_HOST_MSC =y
    CONFIG_FATFS =y
    CONFIG_FATFS_USBH =y

endif
```

## examples/peripherals/audio/audac_play_from_mem/defconfig
```kconfig
CONFIG_QCC74xLOG =n
CONFIG_FREERTOS        =y
CONFIG_VSNPRINTF_FLOAT =y
CONFIG_VSNPRINTF_FLOAT_EX =y
CONFIG_VSNPRINTF_LONG_LONG =y
```

## examples/peripherals/spi/spisync/defconfig
```kconfig
# Components
CONFIG_QCC74xLOG =n
CONFIG_FREERTOS =y
CONFIG_TLSF =y
CONFIG_SHELL =y
CONFIG_NETBUS =y
CONFIG_ATMODULE_SPISYNC =y

CONFIG_VSNPRINTF_FLOAT =y
CONFIG_VSNPRINTF_FLOAT_EX =y
CONFIG_VSNPRINTF_LONG_LONG =y

CONFIG_PS_EXTEND =y
```
