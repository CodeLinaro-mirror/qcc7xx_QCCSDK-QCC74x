## examples/pmu/wl_ble_lp/defconfig
```kconfig
CONFIG_NEWLIB =n
CONFIG_NEWLIB_STANDARD =n
CONFIG_TLSF =y
CONFIG_SHELL =y
CONFIG_LWIP =y
CONFIG_WIFI6 =y
CONFIG_RF =y
CONFIG_MBEDTLS =y
CONFIG_DHCPD =y
CONFIG_PING =y

CONFIG_VSNPRINTF_NANO =n
CONFIG_VSNPRINTF_FLOAT =y
CONFIG_VSNPRINTF_FLOAT_EX =y
CONFIG_VSNPRINTF_LONG_LONG =y

# Config
## mbedtls

CONFIG_MBEDTLS_AES_USE_HW =n
CONFIG_MBEDTLS_BIGNUM_USE_HW =n
CONFIG_MBEDTLS_ECC_USE_HW =n
CONFIG_MBEDTLS_SHA1_USE_HW =n
CONFIG_MBEDTLS_SHA256_USE_HW =n
CONFIG_MBEDTLS_SHA512_USE_HW =n

#wifi
CONFIG_VIF_MAX =2
CONFIG_STA_MAX =4
CONFIG_MAC_TXQ_DEPTH =8
CONFIG_MAC_RXQ_DEPTH =12

#lpfw
CONFIG_LPAPP =y
CONFIG_POST_BUILDS_CONCAT_WITH_LP_FW =y
CONFIG_PM =y
CONFIG_LWIP_LP =y


# DCDC ENABLE
CONFIG_DCDC_ENABLE =n

CONFIG_QCC74xLOG =n
CONFIG_FREERTOS =y
ifeq ($(CONFIG_BLE_ENABLE),y)
    CONFIG_BLUETOOTH =y
    CONFIG_BTBLECONTROLLER_LIB =ble1m2s1bredr0
    CONFIG_BLE_USE_MAC2 =n
    CONFIG_BT_STACK_CLI =y
    CONFIG_TICKLESS_WIFI_BLE =y
else
    CONFIG_TICKLESS_WIFI_BLE =y
endif
# easyflash
CONFIG_LITTLEFS =y
CONFIG_LITTLEFS_KV_EASYFLASH =y
CONFIG_QCC74x_MTD =y
CONFIG_PARTITION =y

# usbh msc
ifeq ($(CONFIG_USBH_MSC),y)
    CONFIG_CHERRYUSB =y
    CONFIG_CHERRYUSB_OSAL =freertos
    CONFIG_CHERRYUSB_HOST =y
    CONFIG_CHERRYUSB_HOST_MSC =y
    CONFIG_FATFS =y
    CONFIG_FATFS_USBH =y
endif
```

## examples/thread/openthread_cli/defconfig
```kconfig
CONFIG_NEWLIB =n
CONFIG_NEWLIB_STANDARD =n

CONFIG_VSNPRINTF_NANO =y
CONFIG_VSNPRINTF_FLOAT =y
CONFIG_VSNPRINTF_FLOAT_EX =y
CONFIG_VSNPRINTF_LONG_LONG =y

CONFIG_LITTLEFS =y
CONFIG_EASYFLASH4 =n
CONFIG_QCC74x_MTD =y
CONFIG_PARTITION =y

CONFIG_MBEDTLS =y
CONFIG_MBEDTLS_AES_USE_HW =n
CONFIG_MBEDTLS_BIGNUM_USE_HW =n
CONFIG_MBEDTLS_ECC_USE_HW =n
CONFIG_MBEDTLS_SHA1_USE_HW =n
CONFIG_MBEDTLS_SHA256_USE_HW =n
CONFIG_MBEDTLS_SHA512_USE_HW =n

CONFIG_QCC74xLOG =n

CONFIG_RF =y
CONFIG_LMAC154 =y
CONFIG_FREERTOS =y
CONFIG_THREAD =y
CONFIG_COREDUMP =y

ifeq ($(CONFIG_WIFI6),y)
	CONFIG_WIFI6 =y
	CONFIG_VIF_MAX =2
	CONFIG_STA_MAX =4
	ifeq ($(CONFIG_BLUETOOTH),y)
		CONFIG_MAC_TXQ_DEPTH =12
	else
		CONFIG_MAC_TXQ_DEPTH =32
	endif
	CONFIG_MAC_RXQ_DEPTH =12
	CONFIG_LWIP =y
	CONFIG_DHCPD =y
	CONFIG_PING =n
endif

ifeq ($(CONFIG_BLUETOOTH),y)
    CONFIG_BLUETOOTH =y
    CONFIG_BTBLECONTROLLER_LIB =ble1m2s1bredr0
	CONFIG_BT_SETTINGS =y
    CONFIG_DISABLE_BT_HOST_PRIVACY =y
    CONFIG_BLE_USE_MAC2 =n
	CONFIG_BT_STACK_CLI =y
    CONFIG_LITTLEFS_KV_EASYFLASH =$(CONFIG_LITTLEFS)
endif
```

## examples/thread/openthread_wifi_br/defconfig
```kconfig
# Components
CONFIG_NEWLIB =n
CONFIG_NEWLIB_STANDARD =n
CONFIG_QCC74xLOG =n
CONFIG_FREERTOS =y
CONFIG_POSIX =n
CONFIG_TLSF =y
CONFIG_SHELL =y
CONFIG_LWIP =y
CONFIG_WIFI6 =y
CONFIG_RF =y
CONFIG_DHCPD =y
CONFIG_PING =y

CONFIG_QCC74x_MTD =y
CONFIG_PARTITION =y
CONFIG_LITTLEFS =y
CONFIG_EASYFLASH4 =n

CONFIG_VSNPRINTF_NANO =y
CONFIG_VSNPRINTF_FLOAT =n
CONFIG_VSNPRINTF_FLOAT_EX =n
CONFIG_VSNPRINTF_LONG_LONG =y
CONFIG_COREDUMP =y

# mbedtls
CONFIG_MBEDTLS =y
CONFIG_MBEDTLS_AES_USE_HW =n
CONFIG_MBEDTLS_BIGNUM_USE_HW =n
CONFIG_MBEDTLS_ECC_USE_HW =n
CONFIG_MBEDTLS_SHA1_USE_HW =n
CONFIG_MBEDTLS_SHA256_USE_HW =n
CONFIG_MBEDTLS_SHA512_USE_HW =n

# wifi
CONFIG_VIF_MAX =2
CONFIG_STA_MAX =4
CONFIG_MAC_TXQ_DEPTH =32
CONFIG_MAC_RXQ_DEPTH =12

# thread
CONFIG_LMAC154 =y
CONFIG_THREAD =y

CONFIG_OTBR =y
CONFIG_IPV6 =y
```

## examples/wifi/ap_sta_bridge/defconfig
```kconfig
# Components
CONFIG_QCC74xLOG =n
CONFIG_FREERTOS =y
CONFIG_TLSF =y
CONFIG_SHELL =y
CONFIG_LWIP =y
CONFIG_WIFI6 =y
# WiFi STA MAC Address Translation
CONFIG_WIFI_MAT =y
CONFIG_WIFI_MAT_FULL_COPY =y
CONFIG_RF =y
CONFIG_MBEDTLS =y
CONFIG_MBEDTLS_V3 =y
CONFIG_DHCPD =y
CONFIG_PING =y
#CONFIG_MQTT =y
CONFIG_NETBUS =y
CONFIG_NETIFD_NANO =y

CONFIG_VSNPRINTF_FLOAT =y
CONFIG_VSNPRINTF_FLOAT_EX =y
CONFIG_VSNPRINTF_LONG_LONG =y

# mbedtls
CONFIG_MBEDTLS_AES_USE_HW =y
CONFIG_MBEDTLS_BIGNUM_USE_HW =y
CONFIG_MBEDTLS_ECC_USE_HW =y
CONFIG_MBEDTLS_SHA1_USE_HW =y
CONFIG_MBEDTLS_SHA256_USE_HW =y
CONFIG_MBEDTLS_SHA512_USE_HW =y

# wifi
CONFIG_VIF_MAX =2
CONFIG_STA_MAX =4
CONFIG_MAC_TXQ_DEPTH =32
CONFIG_MAC_RXQ_DEPTH =12

#CONFIG_PSRAM_COPY_CODE =y
```

## examples/wifi/coex/wifi_ble/defconfig
```kconfig
CONFIG_QCC74xLOG =n
CONFIG_FREERTOS =y
CONFIG_SHELL =y
CONFIG_BLUETOOTH =y
CONFIG_BTBLECONTROLLER_LIB =ble1m10s1bredr0
CONFIG_RF =y
CONFIG_BLE_USE_MAC2 =n
CONFIG_BT_STACK_CLI =y
CONFIG_QCC74x_MTD =y
CONFIG_PARTITION =y
CONFIG_EASYFLASH4 =y
#CONFIG_LITTLEFS =y
#CONFIG_LITTLEFS_KV_EASYFLASH =y

CONFIG_MBEDTLS =y
CONFIG_MBEDTLS_V3 =y
CONFIG_DHCPD =y
CONFIG_PING =y
CONFIG_LWIP =y

CONFIG_WIFI6 =y
CONFIG_VIF_MAX =2
CONFIG_STA_MAX =4
CONFIG_MAC_TXQ_DEPTH =16
CONFIG_MAC_RXQ_DEPTH =12
```

## examples/wifi/nethub_sdio_wifi/defconfig
```kconfig
CONFIG_VSNPRINTF_FLOAT =y
CONFIG_VSNPRINTF_FLOAT_EX =y
CONFIG_VSNPRINTF_LONG_LONG =y
CONFIG_FREERTOS =y
CONFIG_POSIX =y
CONFIG_TLSF =y
CONFIG_SHELL =y
CONFIG_LWIP =y
CONFIG_MBEDTLS =y
CONFIG_MBEDTLS_V3 =y
CONFIG_DHCPD =y
CONFIG_PING =n
CONFIG_COREDUMP =y

# easyflash
CONFIG_LITTLEFS =y
CONFIG_LITTLEFS_KV_EASYFLASH =y
CONFIG_QCC74x_MTD =y
CONFIG_PARTITION =y

CONFIG_MAC_TXQ_DEPTH =12
CONFIG_MAC_RXQ_DEPTH =12
ifeq ($(CONFIG_USE_LPAPP),y)
    CONFIG_LPAPP =y
    CONFIG_PM =y
    CONFIG_LWIP_LP =y
    CONFIG_DCDC_ENABLE =n
    CONFIG_TICKLESS_WIFI_BLE =y
    CONFIG_POST_BUILDS_CONCAT_WITH_LP_FW =y
endif

# BSP
CONFIG_BSP_ETH_PHY =y

# mbedtls
CONFIG_MBEDTLS_AES_USE_HW =y
CONFIG_MBEDTLS_BIGNUM_USE_HW =n
CONFIG_MBEDTLS_ECC_USE_HW =y
CONFIG_MBEDTLS_SHA1_USE_HW =y
CONFIG_MBEDTLS_SHA256_USE_HW =y
CONFIG_MBEDTLS_SHA512_USE_HW =y

# wifi
CONFIG_WIFI_IPERF =n
CONFIG_WIFI6 =y
CONFIG_FHOST =y
CONFIG_RF =y

CONFIG_NETBUS =y
CONFIG_NETHUB =y
CONFIG_NETHUB_CTRLCHANNEL_USE_ATMODULE =y
CONFIG_NETHUB_PROFILE_SDIO =y
CONFIG_NETHUB_PROFILE_USB =n
#CONFIG_NETHUB_NETLINK =y

# Message Router
CONFIG_BSP_MR =y
CONFIG_MR_SDIO_DRIVER =y
CONFIG_MR_SDIO_QUEUE_DEPTH =16
CONFIG_MR_NETDEV =y
CONFIG_MR_TTY =y
CONFIG_MR_VIRTUALCHAN =n
CONFIG_MR_HCI =y

#ble
CONFIG_NXSDIO_HCI =y
CONFIG_BLUETOOTH =y
CONFIG_BTBLECONTROLLER_LIB =blesdiohci
CONFIG_BLE_USE_MAC2 =n

# AT
CONFIG_ATMOUDLE =y
CONFIG_ATMODULE_TTY =y
CONFIG_POST_BUILDS_GENERATE_LITTLEFS =y
#CONFIG_IPV6               =y

CONFIG_OVERRIDE_PTFILE =4M.toml
```

## examples/wifi/sdio_wifi/defconfig
```kconfig
CONFIG_NEWLIB =n
CONFIG_NEWLIB_STANDARD =n

# Components
CONFIG_QCC74xLOG =n
CONFIG_FREERTOS =y
CONFIG_POSIX =y
CONFIG_TLSF =y
CONFIG_SHELL =y
CONFIG_LWIP =y
CONFIG_WIFI6 =y
CONFIG_RF =y
CONFIG_MBEDTLS =y
CONFIG_MBEDTLS_V3 =y
#CONFIG_PSRAM =y
CONFIG_DHCPD =y
CONFIG_PING =y
#CONFIG_MQTT =y
CONFIG_QCC74x_MTD =y
CONFIG_PARTITION =y

CONFIG_VSNPRINTF_NANO =n
CONFIG_VSNPRINTF_FLOAT =y
CONFIG_VSNPRINTF_FLOAT_EX =y
CONFIG_VSNPRINTF_LONG_LONG =y

# easyflash
CONFIG_LITTLEFS =y
CONFIG_LITTLEFS_KV_EASYFLASH =y
CONFIG_QCC74x_MTD =y
CONFIG_PARTITION =y

# Config
## mbedtls
CONFIG_MBEDTLS_AES_USE_HW =n
CONFIG_MBEDTLS_BIGNUM_USE_HW =n
CONFIG_MBEDTLS_ECC_USE_HW =n
CONFIG_MBEDTLS_SHA1_USE_HW =n
CONFIG_MBEDTLS_SHA256_USE_HW =n
CONFIG_MBEDTLS_SHA512_USE_HW =n

# wifi
CONFIG_VIF_MAX =2
CONFIG_STA_MAX =4
CONFIG_MAC_TXQ_DEPTH =8
CONFIG_MAC_RXQ_DEPTH =12

#CONFIG_LOG_DISABLE =n
#CONFIG_ASSERT_DISABLE =n
#CONFIG_LOG_LEVEL =3
#CONFIG_LOG_POOL_SIZE =1024

# DCDC ENABLE
CONFIG_DCDC_ENABLE =n

# sdio
CONFIG_HOSTROUTER =y
CONFIG_DHCP_IN_EMB =y
#CFG_QCC743 =y
CONFIG_NETBUS =y

ifeq ($(CONFIG_LPAPP),y)
    CONFIG_TICKLESS_WIFI =y
    CONFIG_SDIO_LPAPP =y
    CONFIG_POST_BUILDS_CONCAT_WITH_LP_FW =y
    CONFIG_PM =y
    CONFIG_LWIP_LP =y
endif
```

## examples/wifi/spi_wifi/defconfig
```kconfig
# Components
CONFIG_QCC74xLOG =n
CONFIG_FREERTOS =y
CONFIG_POSIX =y
CONFIG_TLSF =y
CONFIG_SHELL =n
CONFIG_LWIP =y
CONFIG_WIFI6 =y
CONFIG_MBEDTLS =y
CONFIG_MBEDTLS_V3 =y
CONFIG_RF =y
#setCONFIG_PSRAM_COPY_CODE =y
CONFIG_DHCPD =y
CONFIG_PING =y
CONFIG_LWIP_ALTCP =y
CONFIG_NETBUS =y
CONFIG_ATMODULE_NXSPI =y
CONFIG_ATMOUDLE =y
CONFIG_POST_BUILDS_GENERATE_LITTLEFS =y

# easyflash
CONFIG_LITTLEFS =y
CONFIG_LITTLEFS_KV_EASYFLASH =y
CONFIG_QCC74x_MTD =y
CONFIG_PARTITION =y

CONFIG_VSNPRINTF_FLOAT      =y
CONFIG_VSNPRINTF_FLOAT_EX   =y
CONFIG_VSNPRINTF_LONG_LONG  =y

# mbedtls
CONFIG_MBEDTLS_AES_USE_HW =y
CONFIG_MBEDTLS_BIGNUM_USE_HW =n
CONFIG_MBEDTLS_ECC_USE_HW =y
CONFIG_MBEDTLS_SHA1_USE_HW =y
CONFIG_MBEDTLS_SHA256_USE_HW =y
CONFIG_MBEDTLS_SHA512_USE_HW =y

ifeq ($(CONFIG_SHELL),y)
CONFIG_PS_EXTEND =y
else
CONFIG_PS_EXTEND =n
endif
CONFIG_TLSF_DEBUG =y
# wifi
CONFIG_VIF_MAX =2
CONFIG_STA_MAX =4

ifeq ($(CONFIG_LWIP_ONHOST_ENABLE),y)
CONFIG_NXSPI_NET =y
ifeq ($(CONFIG_HCI_SPI_ENABLE),y)
CONFIG_NXSPI_HCI =y
else ifeq ($(CONFIG_HCI_UART_ENABLE),y)
CONFIG_NXUART_HCI =y
endif
endif

CONFIG_MAC_TXQ_DEPTH =12
CONFIG_MAC_RXQ_DEPTH =12

ifeq ($(CONFIG_USE_LPAPP),y)
    CONFIG_LPAPP =y
    CONFIG_PM =y
    CONFIG_LWIP_LP =y
    CONFIG_DCDC_ENABLE =n
    CONFIG_TICKLESS_WIFI_BLE =y
    CONFIG_POST_BUILDS_CONCAT_WITH_LP_FW =y
endif

CONFIG_SPI_3PIN_MODE_ENABLE =y
#CONFIG_AT_DEBUG_ENABLE =y

ifeq ($(CONFIG_BLUETOOTH_APP),y)
    CONFIG_BLUETOOTH =y
    CONFIG_BTBLECONTROLLER_LIB =ble1m10s1bredr0
    CONFIG_DISABLE_BT_HOST_PRIVACY =y
    CONFIG_DYNAMIC_GATTS =y
    CONFIG_BT_SMP =y
    CONFIG_BT_SETTINGS =y
    CONFIG_BLE_USE_MAC2 =n
    CONFIG_BT_STACK_CLI =n
    # ATT MTU 512; RX buffer includes 8 bytes of HCI ACL and L2CAP headers.
    CONFIG_BT_L2CAP_TX_MTU =512
    CONFIG_BT_RX_BUF_LEN =520

    # BLE profile
    CONFIG_BT_BAS_SERVER =y
    CONFIG_BT_IAS_SERVER =y
    CONFIG_BT_DIS_SERVER =y
else
    ifeq ($(CONFIG_HCI_SPI_ENABLE),y)
        CONFIG_BLUETOOTH =y
        CONFIG_BTBLECONTROLLER_LIB =blespihci
        CONFIG_BLE_USE_MAC2 =n
    else ifeq ($(CONFIG_HCI_UART_ENABLE),y)
        CONFIG_BLUETOOTH =y
        CONFIG_BTBLECONTROLLER_LIB =bleuarthci
        CONFIG_BLE_USE_MAC2 =n
    endif
endif

ifeq ($(or $(CONFIG_OT_RCP),$(CONFIG_OT_NCP)),y)
    CONFIG_LMAC154                     =y
    CONFIG_THREAD                      =y
    CONFIG_NXSPI_OPENTHREAD_RADIO      =y
    CONFIG_OT_MTD                      =n
    ifeq ($(CONFIG_OT_NCP),y)
        CONFIG_OT_FTD = y
    else()
        CONFIG_OT_FTD = n
    endif
endif

#set local 4M.toml 
CONFIG_OVERRIDE_PTFILE =4M.toml

#CONFIG_OVERRIDE_PTFILE =partition_cfg_8M.toml
```

## examples/wifi/sta/smartconfig_ble/defconfig
```kconfig
# Components
CONFIG_QCC74xLOG =n
CONFIG_FREERTOS =y
CONFIG_TLSF =y
CONFIG_SHELL =y
CONFIG_LWIP =y
CONFIG_WIFI6 =y
CONFIG_RF =y
CONFIG_MBEDTLS =y
CONFIG_MBEDTLS_V3 =y
#CONFIG_PSRAM_HEAP =y
CONFIG_DHCPD =y
CONFIG_PING =y
#CONFIG_MQTT =y
CONFIG_QCC74x_MTD =y
CONFIG_PARTITION =y
CONFIG_EASYFLASH4 =y

CONFIG_VSNPRINTF_FLOAT =y
CONFIG_VSNPRINTF_FLOAT_EX =y
CONFIG_VSNPRINTF_LONG_LONG =y

# mbedtls
CONFIG_MBEDTLS_AES_USE_HW =n
CONFIG_MBEDTLS_BIGNUM_USE_HW =n
CONFIG_MBEDTLS_ECC_USE_HW =n
CONFIG_MBEDTLS_SHA1_USE_HW =n
CONFIG_MBEDTLS_SHA256_USE_HW =n
CONFIG_MBEDTLS_SHA512_USE_HW =n

# wifi
CONFIG_VIF_MAX =2
CONFIG_STA_MAX =4
CONFIG_MAC_TXQ_DEPTH =16
CONFIG_MAC_RXQ_DEPTH =12

# ble
CONFIG_BLUETOOTH =y
CONFIG_BTBLECONTROLLER_LIB =ble1m0s1bredr0
CONFIG_BLE_USE_MAC2 =n
CONFIG_BLE_TP_SERVER =y
CONFIG_QCC74xSYNC =y
```

## examples/wifi/uart_wifi/defconfig
```kconfig
# Components
CONFIG_QCC74xLOG =n
CONFIG_FREERTOS =y
CONFIG_POSIX =y
CONFIG_TLSF =y
CONFIG_SHELL =y
CONFIG_LWIP =y
CONFIG_WIFI6 =y
CONFIG_RF =y
CONFIG_MBEDTLS =y
CONFIG_MBEDTLS_V3 =y
#CONFIG_PSRAM_COPY_CODE =y
CONFIG_DHCPD =y
CONFIG_PING =y
#CONFIG_MQTT =y
CONFIG_NETBUS =y
CONFIG_ATMODULE_UART =y
CONFIG_LWIP_ALTCP =y
CONFIG_ATMOUDLE =y
CONFIG_POST_BUILDS_GENERATE_LITTLEFS =y

# easyflash
CONFIG_LITTLEFS =y
CONFIG_LITTLEFS_KV_EASYFLASH =y
CONFIG_QCC74x_MTD =y
CONFIG_PARTITION =y

CONFIG_MQTT =y

CONFIG_VSNPRINTF_FLOAT =y
CONFIG_VSNPRINTF_FLOAT_EX =y
CONFIG_VSNPRINTF_LONG_LONG =y

# mbedtls
CONFIG_MBEDTLS_AES_USE_HW =n
CONFIG_MBEDTLS_BIGNUM_USE_HW =n
CONFIG_MBEDTLS_ECC_USE_HW =n
CONFIG_MBEDTLS_SHA1_USE_HW =n
CONFIG_MBEDTLS_SHA256_USE_HW =n
CONFIG_MBEDTLS_SHA512_USE_HW =n

CONFIG_PS_EXTEND =y
# wifi
CONFIG_VIF_MAX =2
CONFIG_STA_MAX =4

#CONFIG_USE_LPAPP =y
CONFIG_ANTENNA_CONTROL =y

ifeq ($(CONFIG_USE_LPAPP),y)
    CONFIG_LPAPP =y
    CONFIG_PM =y
    CONFIG_LWIP_LP =y
    CONFIG_MAC_TXQ_DEPTH =8
    CONFIG_MAC_RXQ_DEPTH =12
    CONFIG_DCDC_ENABLE =n
    CONFIG_TICKLESS_WIFI_BLE =y
    CONFIG_POST_BUILDS_CONCAT_WITH_LP_FW =y
else
    CONFIG_MAC_TXQ_DEPTH =16
    CONFIG_MAC_RXQ_DEPTH =12
endif

CONFIG_BLUETOOTH_APP =y
ifeq ($(CONFIG_BLUETOOTH_APP),y)
    CONFIG_BLUETOOTH =y
    CONFIG_BTBLECONTROLLER_LIB =ble1m2s1bredr0
    CONFIG_DISABLE_BT_HOST_PRIVACY =y
    CONFIG_DYNAMIC_GATTS =y
    CONFIG_BT_SMP =y
    CONFIG_BT_SETTINGS =y
    CONFIG_BLE_USE_MAC2 =n
    CONFIG_BT_STACK_CLI =n

    # BLE profile
    CONFIG_BT_BAS_SERVER =y
    CONFIG_BT_IAS_SERVER =y
    CONFIG_BT_DIS_SERVER =y
endif

#set local 4M.toml
CONFIG_OVERRIDE_PTFILE =4M.toml
```

## examples/wifi/wfa/defconfig
```kconfig
# Components
CONFIG_QCC74xLOG =n
CONFIG_FREERTOS =y
CONFIG_TLSF =y
CONFIG_SHELL =y
CONFIG_LWIP =y
CONFIG_WIFI6 =y
CONFIG_RF =y
CONFIG_MBEDTLS =y
CONFIG_MBEDTLS_V3 =y
CONFIG_DHCPD =y
CONFIG_PING =y
#CONFIG_MQTT =y

CONFIG_VSNPRINTF_FLOAT =y
CONFIG_VSNPRINTF_FLOAT_EX =y
CONFIG_VSNPRINTF_LONG_LONG =y

# mbedtls
CONFIG_MBEDTLS_AES_USE_HW =n
CONFIG_MBEDTLS_BIGNUM_USE_HW =n
CONFIG_MBEDTLS_ECC_USE_HW =n
CONFIG_MBEDTLS_SHA1_USE_HW =n
CONFIG_MBEDTLS_SHA256_USE_HW =n
CONFIG_MBEDTLS_SHA512_USE_HW =n

# wifi
CONFIG_VIF_MAX =2
CONFIG_STA_MAX =4
CONFIG_MAC_TXQ_DEPTH =32
CONFIG_MAC_RXQ_DEPTH =12
CONFIG_WIFI_IPERF =y
CONFIG_WIFI_TG =y

CONFIG_WFA =y

ifeq ($(CONFIG_PSRAM),y)
    CONFIG_PSRAM_COPY_CODE =y
else
    CONFIG_HIGH_ISR_STACK =y
    CONFIG_MM_SUSPEND_ALL_LOCKER =y
endif

CONFIG_OVERRIDE_BOOT2FILE =wfa_boot2.bin
```
